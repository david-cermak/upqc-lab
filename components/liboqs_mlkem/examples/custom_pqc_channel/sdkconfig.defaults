## components/liboqs_mlkem/examples/custom_pqc_channel/sdkconfig.defaults
```kconfig
CONFIG_ESP_MAIN_TASK_STACK_SIZE=32768
CONFIG_MBEDTLS_HKDF_C=y
CONFIG_MBEDTLS_AES_C=y
CONFIG_MBEDTLS_GCM_C=y
CONFIG_MBEDTLS_SSL_PROTO_TLS1_3=y
CONFIG_MBEDTLS_UPQC_ENABLE_HYBRID_11EC=y
```

## hybrid/target_client/sdkconfig.defaults.esp32
```kconfig
CONFIG_ESP_MAIN_TASK_STACK_SIZE=32768
CONFIG_MBEDTLS_SSL_PROTO_TLS1_3=y
CONFIG_MBEDTLS_UPQC_ENABLE_HYBRID_11EC=y
```
